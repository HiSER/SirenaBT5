/**
 * HiSER (c)2019 Litvin Artem Vasilyevich
 * Date 9 мар. 2019 г.
 * sirenabt5@artemlitvin.com
 */

#include <sirena.hpp>

const uint8 SIRENA::standardWave[] =
	{
		0x7D, 0x73, 0x7F, 0x86, 0x6E, 0x71, 0x8D, 0x99, 0x7B, 0x81, 0x8E, 0x8A, 0x7F, 0x7B, 0x88, 0x8D,
		0x8A, 0x7E, 0x6E, 0x5F, 0x62, 0x87, 0x95, 0x7A, 0x78, 0x88, 0x8A, 0x66, 0x72, 0x93, 0xA4, 0xAA,
		0x98, 0x7A, 0x67, 0x68, 0x67, 0x74, 0x71, 0x7A, 0x97, 0xA6, 0x74, 0x5E, 0x72, 0x7D, 0x6E, 0x8C,
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		0x66, 0x74, 0x7E, 0x93, 0x9E, 0xA2, 0x88, 0x5F, 0x5C, 0x74, 0x83, 0x8A, 0xA1, 0x99, 0x88, 0x73
	};

bool SIRENA::cfgSleep;
TIMER* SIRENA::powerOff;
CH::tEvent SIRENA::event;
SIRENA::tPlay SIRENA::play[];
sint8 SIRENA::lostEventId;

void SIRENA::Init(void)
{
	DBGP_NOTICE("SIRENA: init");

	RCC_AHBPeriphClockCmd(RCC_AHBPeriph_GPIOB, ENABLE);

	GPIO_InitTypeDef pin;
	pin.GPIO_Pin	= GPIO_Pin_9;
	pin.GPIO_Mode	= GPIO_Mode_OUT;
	pin.GPIO_Speed	= GPIO_Speed_Level_1;
	pin.GPIO_OType	= GPIO_OType_PP;
	pin.GPIO_PuPd	= GPIO_PuPd_NOPULL;
	GPIO_Init(GPIOB, &pin);

	powerOff = new TIMER();
	lostEventId = -1;
	cfgSleep = true;

	resetPower();

	uint8 i;
	for (i = 0; i <= CH::CHANNELS; i++)
	{
		play[i].stream = NULL;
		play[i].pause = false;
		play[i].stop = false;
		play[i].reset = false;
		play[i].playing = false;
		play[i].beep.time = new TIMER();
		play[i].beep.enable = false;
	}

	CALL::setInterval(ThreadPower, 1000);
	CALL::setImmediate(Thread);

	//AMP::set(44100);
	//DBGF("DATA: open %s", STRBOOL(FS::open(1104, 350711, readCallback, 1000)));

	/*play.melody.address = 1104;
	play.melody.length = 350711;
	play.melody.samples = 44100;
	playRoutione();*/

	/*play.event.lengthType = (PIN::ePulseType)2;
	play.event.pulseType[0].width = 300;
	play.event.pulseType[0].count = 3;
	play.event.pulseType[1].width = 600;
	play.event.pulseType[1].count = 2;
	play.beep.enable = false;*/
	//beepRoutine();

	DBGP_NOTICE("SIRENA: ok");
}

void SIRENA::DeInit(void)
{

}

void SIRENA::resetPower()
{
	if ((GPIOB->ODR & GPIO_Pin_9) == 0)
	{
		GPIOB->BSRR = GPIO_Pin_9;
		DBGP_NOTICE("SIRENA: on");
	}
	powerOff->set(POWEROFF_TIMEOUT);
}

void SIRENA::ThreadPower(__UNUSED void *param)
{
	if
	(
		   !cfgSleep
		|| BT::connected()
		|| CH::active()
		|| play[0].stream != NULL
		|| play[0].beep.enable
		|| play[1].stream != NULL
		|| play[1].beep.enable
		|| play[2].stream != NULL
		|| play[2].beep.enable
	)
	{
		resetPower();
	}
	if ((GPIOB->ODR & GPIO_Pin_9) != 0 && powerOff->finish())
	{
		DBGP_NOTICE("SIRENA: off");
		GPIOB->BRR = GPIO_Pin_9;
	}
}

void SIRENA::Thread(__UNUSED void *param)
{
	if (CH::event(&event))
	{
		resetPower();

		char* tmp = eventToStr(&event);
		if (BT::connected())
		{
			BT::write("+EVENT:");
			BT::send(tmp);
		}
		DBGF_NOTICE("SIRENA: %s", tmp);
		free(tmp);

		if (event.lengthType == PIN::eptPress || event.lengthType == PIN::eptCyclic || event.lengthType > 0)
		{
			play[event.index - 1].playing = true;
			FS::findMelodyCreate(&event, findCallback);
		}
		else if (event.lengthType == PIN::eptRelease)
		{
			playStop(event.index);
		}
	}
	CALL::setImmediate(Thread);
}

void SIRENA::prePlay(uint8 index)
{
	play[3].playing = true;
	FS::preMelodyCreate(index, findCallback);
}

void SIRENA::preStop(void)
{
	playStop(CH::CHANNELS + 1);
}

void SIRENA::findCallback(FS::tFindMelody* find)
{
	DBGF_NOTICE("SIRENA: ch %i melody %i, %i", find->event.index, find->melodyIndex, (int)find->melody.address);
	uint8 index = find->event.index - 1;
	if (
	    (/*find->event.index == 1*/ CH::standard(find->event.index - 1) || find->melody.address > 0)
	    && (find->noPlayAfter == -1 || find->noPlayAfter != lostEventId)
	)
	{
		playOtherPause(find->event.index);
		memcpy(&play[index].event, &find->event, sizeof(find->event));
		memcpy(&play[index].melody, &find->melody, sizeof(find->melody));
		play[index].melodyIndex = find->melodyIndex;
		play[index].poweroff = find->poweroff;
		play[index].volume = find->volume;
		playStart(find->event.index);
	}
	else if (find->event.index == 4)
	{
		char* tmp = (char*)malloc(32);
		sprintf(tmp, "{\"index\":%i}", find->melodyIndex);
		BT::write("+PLAYSTOP:");
		BT::send(tmp);
		sprintf(tmp, "%i", find->melodyIndex);
		DBG::write("+PLAYSTOP:");
		DBG::send(tmp);
		free(tmp);
	}
	else
	{
		play[index].playing = false;
	}
	lostEventId = find->eventId;
	FS::findMelodyRemove(find);
}

void SIRENA::playStart(uint8 chIndex)
{
	tPlay* p = &play[chIndex - 1];
	p->playing = true;
	if (p->stream == NULL && !p->beep.enable)
	{
		playRoutione((FS::tStreamRead*)((uint32)chIndex - 1));
	}
	else
	{
		p->reset = true;
	}
}

void SIRENA::playStop(uint8 chIndex)
{
	tPlay* p = &play[chIndex - 1];
	if (p->event.playToEnd)
	{
		p->event.playOnce = true;
	}
	else if (p->playing)
	{
		p->stop = true;
	}
}

void SIRENA::playOtherPause(uint8 chIndex)
{
	uint8 i;
	chIndex -= 1;
	for (i = 0; i <= CH::CHANNELS; i++)
	{
		if (chIndex != i && (play[i].stream != NULL || play[i].beep.enable) && !play[i].stop)
		{
			play[i].pause = true;
		}
	}
}

bool SIRENA::playHasPause(void)
{
	uint8 i;
	for (i = 0; i <= CH::CHANNELS; i++)
	{
		if ((play[i].stream != NULL || play[i].beep.enable) && !play[i].stop && play[i].pause)
		{
			AMP::set((play[i].beep.enable) ? standardWaveSamples : play[i].melody.samples);
			play[i].pause = false;
			return true;
			break;
		}
	}
	return false;
}

void SIRENA::beepRoutine(uint8 index)
{
	tPlay* p = &play[index];
	if (p->beep.enable)
	{
		if (p->stop || p->reset)
		{
			p->stop = false;
			p->pause = false;
			p->playing = false;
			p->beep.enable = false;
			if (p->reset)
			{
				p->reset = false;
				p->playing = true;
				CALL::setImmediate((CALL::tCallback)playRoutione, (void*)((uint32)index));
			}
			else
			{
				if (!playHasPause() && p->poweroff)
				{
					powerOff->set(POWEROFF_DELAY);
				}
			}
		}
		else if (p->pause)
		{
			CALL::setTimeout((CALL::tCallback)beepRoutine, 10, (void*)((uint32)index));
		}
		else
		{
			if (p->beep.active)
			{
				uint16 length = AMP::write(&standardWave[p->beep.offset], p->beep.length);
				if (length < p->beep.length)
				{
					p->beep.offset += length;
					p->beep.length -= length;
				}
				else
				{
					if (p->event.playOnce)
					{
						p->stop = true;
					}
					p->beep.length = sizeof(standardWave);
					p->beep.offset = 0;
				}
				if (p->event.lengthType > 0 && p->beep.time->finish())
				{
					p->beep.time->set(400);
					p->beep.active = false;
					p->beep.pulses++;
					if (p->beep.pulses >= p->event.pulseType[p->beep.types].count)
					{
						p->beep.pulses = 0;
						p->beep.types++;
						if (p->beep.types >= p->event.lengthType)
						{
							p->stop = true;
						}
					}
				}
			}
			else
			{
				uint8 nullSmp = 0x80;
				AMP::write(&nullSmp, 1);
				if (p->beep.time->finish())
				{
					p->beep.time->set(p->event.pulseType[p->beep.types].width);
					p->beep.length = sizeof(standardWave);
					p->beep.offset = 0;
					p->beep.active = true;
				}
			}
			CALL::setTimeout((CALL::tCallback)beepRoutine, 2, (void*)((uint32)index));
		}
	}
	else
	{
		AMP::set(standardWaveSamples);
		AMP::volume(AMP::cfgVolumeBeep);
		p->beep.enable = true;
		p->beep.active = (p->event.lengthType == PIN::eptPress || p->event.lengthType == PIN::eptCyclic);
		p->beep.time->set();
		p->beep.pulses = 0;
		p->beep.types = 0;
		CALL::setImmediate((CALL::tCallback)beepRoutine, (void*)((uint32)index));
	}
}

void SIRENA::playRoutione(FS::tStreamRead* stream)
{
	if ((uint32)stream <= CH::CHANNELS)
	{
		uint8 i = (uint32)stream;
		if (play[i].melody.address > 0)
		{
			AMP::set(play[i].melody.samples);
			AMP::volume(play[i].volume);
			play[i].stream = FS::open(play[i].melody.address, play[i].melody.length, playRoutione, 1000, &play[i]);
		}
		else
		{
			beepRoutine(i);
		}
		return;
	}
	tPlay* p = (tPlay*)stream->tag;
	if (p != NULL)
	{
		if (p->stop || p->reset)
		{
			p->stop = false;
			p->pause = false;
			p->playing = false;
			FS::close(stream);
			p->stream = NULL;
			if (p->reset)
			{
				p->reset = false;
				p->playing = true;
				CALL::setImmediate((CALL::tCallback)playRoutione, (void*)(p->event.index - 1));
			}
			else
			{
				if (!playHasPause() && p->poweroff)
				{
					powerOff->set(POWEROFF_DELAY);
				}
			}
		}
		else if (p->pause)
		{
			CALL::setTimeout((CALL::tCallback)playRoutione, 10, stream);
		}
		else
		{
			if (stream->data.error)
			{
				FS::close(stream);
				p->stream = NULL;
				beepRoutine(p->event.index - 1);
				DBGP_NOTICE("SIRENA: error stream");
			}
			else
			{
				uint16 length = AMP::write(&stream->data.buffer[stream->data.offset], stream->data.length);
				if (length < stream->data.length)
				{
					stream->data.offset += length;
					stream->data.length -= length;
					//CALL::setTimeout((CALL::tCallback)playRoutione, 2, stream);
					CALL::setImmediate((CALL::tCallback)playRoutione, stream);
				}
				else
				{
					if (stream->data.eof)
					{
						FS::close(stream);
						p->stream = NULL;
						if (!p->event.playOnce && (p->event.lengthType == PIN::eptPress || p->event.lengthType == PIN::eptCyclic))
						{
							playStart(p->event.index);
						}
						else
						{
							if (p->event.index == 4)
							{
								char* tmp = (char*)malloc(32);
								sprintf(tmp, "{\"index\":%i}", p->melodyIndex);
								BT::write("+PLAYSTOP:");
								BT::send(tmp);
								sprintf(tmp, "%i", p->melodyIndex);
								DBG::write("+PLAYSTOP:");
								DBG::send(tmp);
								free(tmp);
							}
							if (!playHasPause() && p->poweroff)
							{
								powerOff->set(POWEROFF_DELAY);
							}
							p->playing = false;
						}
					}
					else
					{
						FS::next(stream);
					}
				}
			}
		}
	}
	else
	{
		DBGP_WARNING("SIRENA: no stream");
	}
}

char* SIRENA::eventToStr(CH::tEvent* event)
{
	char* tmp = (char*)malloc(256);
	int l;
	uint8 i;
	bool f;
	l = sprintf(tmp, "{\"index\":%i", event->index);
	if (event->lengthType == PIN::eptNull)
	{
		l += sprintf(&tmp[l], ",\"type\":null");
	}
	else
	{
		if (event->lengthType > PIN::eptNull)
		{
			l += sprintf(&tmp[l], ",\"type\":\"pulse\",\"pulse\":[");
			for (i = 0, f = false; i < event->lengthType; i++)
			{
				if (f)
				{
					tmp[l] = ',';
					l++;
					tmp[l] = '\0';
				}
				else
				{
					f = true;
				}
				l += sprintf(&tmp[l], "{\"width\":%u,\"count\":%u}", event->pulseType[i].width, event->pulseType[i].count);
			}
			l += sprintf(&tmp[l], "]");
		}
		else if (event->lengthType == PIN::eptPress)
		{
			l += sprintf(&tmp[l], ",\"type\":\"press\"");
		}
		else if (event->lengthType == PIN::eptRelease)
		{
			l += sprintf(&tmp[l], ",\"type\":\"release\"");
		}
		else if (event->lengthType == PIN::eptCyclic)
		{
			l += sprintf(&tmp[l], ",\"type\":\"cyclic\"");
		}
		else if (event->lengthType == PIN::eptMeasure)
		{
			l += sprintf(&tmp[l], ",\"type\":\"measure\"");
			l += sprintf(&tmp[l], ",\"measure\":{\"width\":%u,\"idle\":%u}", event->pulseType[0].width, event->pulseType[0].count);
		}
		else if (event->lengthType == PIN::eptErrMeasure)
		{
			l += sprintf(&tmp[l], ",\"type\":\"errMeasure\"");
		}
		else
		{
			l += sprintf(&tmp[l], ",\"type\":\"error\"");
		}
	}
	l += sprintf(&tmp[l], "}");
	//DBGF("SIRENA::eventToStr: %i", l)
	return tmp;
}
